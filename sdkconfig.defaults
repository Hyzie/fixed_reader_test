## sdkconfig.defaults
```kconfig
CONFIG_ESP32_SPIRAM_SUPPORT=y
CONFIG_ESPTOOLPY_FLASHSIZE_4MB=y
CONFIG_PARTITION_TABLE_CUSTOM=y
CONFIG_PARTITION_TABLE_CUSTOM_FILENAME="partitions.csv"
CONFIG_ESP_EVENT_LOOP_PROFILING=n
CONFIG_ESP_HTTP_CLIENT_ENABLE_HTTPS=n
CONFIG_ESP_TLS_SERVER=n
CONFIG_ETH_USE_SPI_ETHERNET=y
CONFIG_ETH_SPI_ETHERNET_W5500=y
CONFIG_ETH_SPI_ETHERNET_KSZ8851SNL=n
CONFIG_ETH_SPI_ETHERNET_DM9051=n
CONFIG_EXAMPLE_ETH_PHY_ADDR=0
CONFIG_EXAMPLE_ETH_PHY_RST_GPIO=7
CONFIG_EXAMPLE_ETH_SPI_HOST=2
CONFIG_EXAMPLE_ETH_SPI_CLOCK_MHZ=20
CONFIG_EXAMPLE_ETH_SPI_INT_GPIO=14
CONFIG_EXAMPLE_ETH_SPI_CS_GPIO=9
CONFIG_EXAMPLE_ETH_SPI_SCLK_GPIO=36
CONFIG_EXAMPLE_ETH_SPI_MOSI_GPIO=37
CONFIG_EXAMPLE_ETH_SPI_MISO_GPIO=35

# Compiler optimizations for size
CONFIG_COMPILER_OPTIMIZATION_SIZE=y
CONFIG_COMPILER_OPTIMIZATION_ASSERTIONS_DISABLE=y

# Disable unused features to save space
CONFIG_ESP_SYSTEM_EVENT_TASK_STACK_SIZE=2048
CONFIG_ESP_MAIN_TASK_STACK_SIZE=3072
CONFIG_ESP_TIMER_TASK_STACK_SIZE=3072
CONFIG_ESP_HTTP_SERVER_WS_SUPPORT=n
CONFIG_ESP_HTTPS_SERVER_ENABLE=n

# Reduce logging levels
CONFIG_LOG_DEFAULT_LEVEL_INFO=y
CONFIG_LOG_MAXIMUM_LEVEL=3

# Disable unused protocols
CONFIG_ESP_NETIF_BR_GLUE_ENABLE=n
CONFIG_ESP_NETIF_L2_TAP=n

# Disable WiFi completely
CONFIG_ESP_WIFI_ENABLED=n

# Disable MQTT
CONFIG_MQTT_PROTOCOL_311=n
CONFIG_MQTT_TRANSPORT_SSL=n
CONFIG_MQTT_TRANSPORT_WEBSOCKET=n

# LWIP optimizations
CONFIG_LWIP_TCP_MSS=1440
CONFIG_LWIP_TCP_RECVMBOX_SIZE=4
CONFIG_LWIP_UDP_RECVMBOX_SIZE=4
CONFIG_LWIP_TCPIP_RECVMBOX_SIZE=16

# Disable unnecessary components
CONFIG_ESP_COREDUMP_ENABLE=n
CONFIG_ESP_ERR_TO_NAME_LOOKUP=n
```
